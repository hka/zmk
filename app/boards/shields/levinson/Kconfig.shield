## app/boards/shields/levinson/Kconfig.shield
```kconfig
# Copyright (c) 2020 Pete Johanson, Kurtis Lew
# SPDX-License-Identifier: MIT

config SHIELD_LEVINSON_LEFT
	def_bool $(shields_list_contains,levinson_left)

config SHIELD_LEVINSON_RIGHT
	def_bool $(shields_list_contains,levinson_right)
```
